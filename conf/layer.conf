## conf/layer.conf
```bitbake
# We have a conf and classes directory, add to BBPATH
BBPATH .= ":${LAYERDIR}"

# We have recipes-* directories, add to BBFILES
BBFILES += "${LAYERDIR}/recipes-*/*/*.bb \
            ${LAYERDIR}/recipes-*/*/*.bbappend"

BBFILE_COLLECTIONS += "meta-zigbee"
BBFILE_PATTERN_meta-zigbee = "^${LAYERDIR}/"
BBFILE_PRIORITY_meta-zigbee = "6"

LAYERDEPENDS_meta-zigbee = "core openembedded-layer"
LAYERSERIES_COMPAT_meta-zigbee = "kirkstone langdale scarthgap"
```

## wic/beaglebone-emmc.wks
```
# BeagleBone Black eMMC layout
# Boot partition: FAT16 for MLO + u-boot
# Root partition: ext4 on remaining eMMC space

part /boot --source bootimg-partition --ondisk mmcblk1 --fstype=vfat --label boot --active --align 4 --size 16
part /     --source rootfs            --ondisk mmcblk1 --fstype=ext4 --label root --align 4
```
